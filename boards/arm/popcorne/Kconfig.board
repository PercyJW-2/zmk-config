## boards/arm/popcorne/Kconfig.board
```kconfig
# Copyright (c) 2025 Joris Wachsmuth
# SPDX-License-Identifier: MIT

config BOARD_POPCORNE
    bool "popcorne"
    depends on SOC_NRF52840_QIAA
```

## boards/arm/popcorne/Kconfig.defconfig
```kconfig
# Copyright (c) 2025 Joris Wachsmuth
# SPDX-License-Identifier: MIT

if BOARD_POPCORNE

config ZMK_KEYBOARD_NAME
    default "popcorne"

if USB_DEVICE_STACK

config USB_NRFX
    default y

endif # USB_DEVICE_STACK

if ZMK_DISPLAY

config I2C
    default y

config SSD1306
    default y

endif # ZMK_DISPLAY

if LVGL

config LV_Z_VDB_SIZE
    default 64

config LV_DPI_DEF
    default 148

config LV_Z_BITS_PER_PIXEL
    default 1

choice LV_COLOR_DEPTH
    default LV_COLOR_DEPTH_1
endchoice

endif # LVGL

config ZMK_KSCAN_MATRIX_POLLING
    default y

config BT_CTLR
    default BT

endif # BOARD_POPCORNE
```

## boards/arm/popcorne/popcorne_defconfig
```kconfig
# Copyright (c) 2025 Joris Wachsmuth
# SPDX-License-Identifier: MIT

CONFIG_SOC_SERIES_NRF52X=y
CONFIG_SOC_NRF52840_QIAA=y
CONFIG_BOARD_POPCORNE=y

# Enable MPU
CONFIG_ARM_MPU=y

CONFIG_PINCTRL=y

# enable GPIO
CONFIG_GPIO=y

CONFIG_USE_DT_CODE_PARTITION=y
CONFIG_BUILD_OUTPUT_UF2=y

CONFIG_MPU_ALLOW_FLASH_WRITE=y
CONFIG_NVS=y
CONFIG_SETTINGS_NVS=y
CONFIG_FLASH=y
CONFIG_FLASH_PAGE_LAYOUT=y
CONFIG_FLASH_MAP=y

CONFIG_ZMK_BATTERY_REPORTING=y

CONFIG_ZMK_RGB_UNDERGLOW=y
CONFIG_LED_STRIP=y

CONFIG_ZMK_RGB_UNDERGLOW_HUE_START=160
CONFIG_ZMK_RGB_UNDERGLOW_EFF_START=0
CONFIG_ZMK_RGB_UNDERGLOW_BRT_START=20

CONFIG_ZMK_DISPLAY=y

CONFIG_EC11=y
CONFIG_EC11_TRIGGER_GLOBAL_THREAD=y


CONFIG_ZMK_USB=y
CONFIG_ZMK_BLE=y
```

## config/west.yml
```yaml
manifest:
  remotes:
    - name: zmkfirmware
      url-base: https://github.com/PercyJW-2
    # Additional modules containing boards/shields/custom code can be listed here as well
    # See https://docs.zephyrproject.org/3.2.0/develop/west/manifest.html#projects
    - name: zmk-modules
      url-base: https://github.com/PercyJW-2
  projects:
    - name: zmk
      remote: zmkfirmware
      revision: main
      import: app/west.yml
    - name: zmk-ws2812-gpio-backport
      remote: zmk-modules
      revision: main
  self:
    path: config
```
